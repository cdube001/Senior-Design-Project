
/*  shiftPi.c
 *  Title: EE175ABC - Senior Design Project: Variable Brightness RGB Persistence of Vision Display
 *
 *  Name & E-mail: Calvin Nguyen - cnguy072@ucr.edu
 *  Partner(s) Name & E-mail: Christopher Dube - cdube001@ucr.edu
 *  Partner(s) Name & E-mail: Benson Ninh - bninh001@ucr.edu
 */

#include <pthread.h>
#include <errno.h>
#include <sched.h>
#include <math.h>
#include <sys/time.h>
#include <time.h>
#include <stdint.h>
#include <unistd.h>
#include <stdio.h>
#include <stdlib.h>
#include <getopt.h>
#include <fcntl.h>
#include <sys/ioctl.h>
#include <linux/types.h>
#include <linux/spi/spidev.h>
#include <sys/mman.h>
#include <sys/time.h>
//#include <wiringPi.h>

// To compile: 
//     g++ -I/usr/local/include -L/usr/local/lib -lwiringPi shiftPi.cpp -o a.out
//     addt. compile flags -I/usr/local/include -L/usr/local/lib -lwiringPi
// 

//=====================================================================================================================
// Constants:

#define REFRESH_HERTZ 9 	// FPS
#define NUM_SHIFTREG 15
#define NUM_BCM_FRAMES 7    // 2 ^ BCM (3) bits
#define X_COORDS 120
#define Y_COORDS 40 		// NUM_SHIFTREG * 8 / 3

#define TIMESYNC_SEC 991500 // Nearly 1 second
#define TIMESYNC_HZ  110000 // TIMESYNC_HZ / REFRESH_HERTZ - 200 //(a little)

#define ARRAY_SIZE(a) (sizeof(a) / sizeof((a)[0]))

// For SPI - spidev related variables
static const char *device = "/dev/spidev0.0";
static uint8_t mode;
static uint8_t bits = 8;
static uint32_t speed = 16000000;
static uint16_t delay;

//=====================================================================================================================
// Structures:

// Define Booleans in C
#define bool char
#define true 1
#define false 0

// Error reporting
static void pabort(const char *s) {
	perror(s);
	abort();
}

// Get the current time in microseconds
unsigned int getTime() {
	struct timeval time;
	gettimeofday(&time, NULL);
	long start = ((unsigned long long)time.tv_sec * 1000000) + time.tv_usec;
	return start;
}

// Calculate the difference from a start time in microseconds
unsigned int getDiff(long start) {
	long next = getTime();
 	long diff = next - start;
 	return diff;
}

//=====================================================================================================================
// Global Variables:

int fd;

uint8_t MAP[X_COORDS * Y_COORDS * 3] = { //24 bits per pixel, true color Bitmap ordered RGB
  0x96, 0xBD, 0x62, 0x95, 0xBC, 0x63, 0xE4, 0xD9, 0xCE, 0xEC, 0xD7, 0xCA,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 0xF4, 
        0xE7, 0xF1, 0xF6, 0xE6, 0xED, 0xF3, 0xE9, 0xF1, 0xF4, 0xEE, 0xF3, 0xF7,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 0xFA, 
        0xF5, 0xF8, 0xFB, 0xF7, 0xF8, 0xFC, 0xF9, 0xFA, 0xFE, 0xFA, 0xFA, 0xFB,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 0x83, 
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        0x61, 0xBD, 0xB7, 0x60, 0xC0, 0xC0
};

// Column output buffer, frame level
int pin_out[NUM_SHIFTREG * 8]; 

// Column output buffer, BCM level
uint8_t tx[] = {
	0x00, 0x00, 0x00, 0x00, 0x00,
	0x00, 0x00, 0x00, 0x00, 0x00,
	0x00, 0x00, 0x00, 0x00, 0x00,
};

// 2048 char array: 256 characters, 8 bytes per character
uint8_t textIndex[] = {
	0x00, 0x00, 0x00, 0x00, 0x00, 0x00, 0x00, 0x00, 0x7E, 0x81, 0xA5, 0x81,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 0x00,
};

// Variables to keep track off scrolling offset
char scroll_offset_X = 0; 
char scroll_offset_Y = 0; //Not yet implemented	

//=====================================================================================================================

void setAll(int color);
void setOne(char y, unsigned char b, unsigned char g, unsigned char r);
void setOneFromMap(char x, char y);
void setMap(int color);
void fillLine(char* str, char strCol, int color);
void scrollMap(long vector);
void printMap();
void clearTX();
void setTX(char frame);
static void transfer(int fd);
void cycleOne(int fd, char x_col, char frame);
void cycle(int fd, char frame);
char* getTimestr();
char* getDatestr();

// Set all LEDs to the color code (eg. #FFFFFF), PCB LEDs are ordered BGR
void setAll(int color) {
	char y;
	for (y = 0; y < Y_COORDS; ++y) {
		pin_out[y*3+0] = ((color & 0x0000FF) >>  0) / 32;
		pin_out[y*3+1] = ((color & 0x00FF00) >>  8) / 32;
		pin_out[y*3+2] = ((color & 0xFF0000) >> 16) / 32;
	}
}

// Set one pin, PCB LEDs are ordered BGR
void setOne(char y, unsigned char b, unsigned char g, unsigned char r) {
	pin_out[y*3+0] = b / 32;
	pin_out[y*3+1] = g / 32;
	pin_out[y*3+2] = r / 32;
}

// Set one pin
void setOneFromMap(char x, char y) {
	setOne(y, 	MAP[x*3 + y*X_COORDS*3 + 2], 
				MAP[x*3 + y*X_COORDS*3 + 1],
				MAP[x*3 + y*X_COORDS*3 + 0]);
}

// set map to color, override
void setMap(int color) {
	char x, y, rgb;
	for (y = 0; y < Y_COORDS; ++y) {
		for (x = 0; x < X_COORDS; ++x) {
			for(rgb = 0; rgb < 3; ++rgb) {
				MAP[x*3 + y*X_COORDS*3 + rgb] = 0x00;
			}
		}
	}
}

//fill Map with color at text,
void fillLine(char* str, char strCol, int color) {
    char charIndex, x, y;  	// character index on for a string row on MAP, limited by X_COORDS
    for (charIndex = 0; charIndex < 15 && str[charIndex] != "\0"; ++charIndex) {
    	for (y = 0; y < 8; ++y) {
    		for(x = 0; x < 8; ++x) {
    			MAP[(charIndex*8+x)*3 + (strCol*8+y)*X_COORDS*3 + 0] = ((textIndex[str[charIndex]           *8 + y] >> (7 - x)) & 1) * ((color & 0xFF0000) >> 16);
    			MAP[(charIndex*8+x)*3 + (strCol*8+y)*X_COORDS*3 + 1] = ((textIndex[str[charIndex]           *8 + y] >> (7 - x)) & 1) * ((color & 0x00FF00) >>  8);
    			MAP[(charIndex*8+x)*3 + (strCol*8+y)*X_COORDS*3 + 2] = ((textIndex[str[charIndex]           *8 + y] >> (7 - x)) & 1) * ((color & 0x0000FF) >>  0);
    		}								                         //((textIndex[ord(string[mapCharIndex])*8 + j] >> (7 - i)) & 1) * color
    	}
    }
}

// Function for modifying the variable scroll_offset_X, prevents it from going out of range
void scrollMap(long vector) {
	scroll_offset_X = scroll_offset_X + vector;
	if(scroll_offset_X >= X_COORDS) {
		scroll_offset_X = scroll_offset_X - X_COORDS;
	} else if( scroll_offset_X < 0) {
		scroll_offset_X = scroll_offset_X + X_COORDS;
	}
	printf("%d", scroll_offset_X);
	puts("");
}

// simple print Map for debugging. if any color is active, display 1, else blank
void printMap() {
	char y;
	long x;
	long pos;
	for (y = 0; y < Y_COORDS; ++y) {
		for (x = 0; x < X_COORDS; ++x) {
			pos = x + scroll_offset_X;
			if(pos >= X_COORDS) pos = pos - X_COORDS;
			if(    MAP[pos*3 + y*X_COORDS*3 + 0] 
				|| MAP[pos*3 + y*X_COORDS*3 + 1] 
				|| MAP[pos*3 + y*X_COORDS*3 + 2]) {
				char temp = (MAP[pos*3 + y*X_COORDS*3 + 0] > MAP[pos*3 + y*X_COORDS*3 + 1]) ? MAP[pos*3 + y*X_COORDS*3 + 0] : MAP[pos*3 + y*X_COORDS*3 + 0];
				temp = (temp > MAP[pos*3 + y*X_COORDS*3 + 2]) ? temp : MAP[pos*3 + y*X_COORDS*3 + 2];
				temp = temp /32;
				printf("%d", temp);
			} else {
				printf(" ");
			}
		}
		puts("");
	}
}

// Clear the TX buffer
void clearTX() {
	char i = 0;
	for(i = 0; i < NUM_SHIFTREG; ++i) {
		tx[i] = 0x00;
	}
}

// Set the TX buffer with pin color data
void setTX(char frame) {
	char i = 0;
	char offset = 0;
	char index = 0;

	for(i = 0; i < NUM_SHIFTREG * 8; ++i) {
		index = (NUM_SHIFTREG - 1) - (i / 8);
		offset = i % 8;
		tx[index] = tx[index] | (((pin_out[i] & frame) >> (frame / 2)) << offset);
	}
}

// Send data out via SPI
static void transfer(int fd) {
	int ret;

	struct spi_ioc_transfer tr = {
		.tx_buf = (unsigned long)tx,
		.len = ARRAY_SIZE(tx),
		.delay_usecs = delay,
		.speed_hz = speed,
		.bits_per_word = bits,
	};

	ret = ioctl(fd, SPI_IOC_MESSAGE(1), &tr);
	if (ret < 1)
		pabort("can't send spi message");
}

// Draw one BCM frame for one X
void cycleOne(int fd, char x_col, char frame) {
	long pos = x_col + scroll_offset_X;
	if(pos >= X_COORDS) pos = pos - X_COORDS;

	clearTX();
	char y;
	for(y = 0; y < Y_COORDS; ++y) {
		setOneFromMap(pos, y);	
	}
	setTX(frame);
	transfer(fd);
}

// Draw all x coordinates for a given BCM frame
void cycle(int fd, char frame) {
	long x;
	
	for(x = 0; x < X_COORDS; ++x) {
		cycleOne(fd, x, frame);
	}
}

char* getTimestr() {
	static char temp[15];
	time_t now = time(NULL);
	struct tm *t = localtime(&now);

	strftime(temp, sizeof(temp)-1, "%X %p %Z", t);
	return temp;
}

char* getDatestr() {
	static char temp[15];
	time_t now = time(NULL);
	struct tm *t = localtime(&now);

	strftime(temp, sizeof(temp)-1, "%B %d, %G", t);
	return temp;
}	

//=====================================================================================================================
// Main

void init(int fd) {
	int ret;

	clearTX();
	transfer(fd);
	printf("CLEAR");
	puts("");
	sleep(1);

	//setMap(0x000000);

	ret = ioctl(fd, SPI_IOC_WR_MODE, &mode);
	if (ret == -1)
		pabort("can't set spi mode");

	ret = ioctl(fd, SPI_IOC_RD_MODE, &mode);
	if (ret == -1)
		pabort("can't get spi mode");

	ret = ioctl(fd, SPI_IOC_WR_BITS_PER_WORD, &bits);
	if (ret == -1)
		pabort("can't set bits per word");

	ret = ioctl(fd, SPI_IOC_RD_BITS_PER_WORD, &bits);
	if (ret == -1)
		pabort("can't get bits per word");

	ret = ioctl(fd, SPI_IOC_WR_MAX_SPEED_HZ, &speed);
	if (ret == -1)
		pabort("can't set max speed hz");

	ret = ioctl(fd, SPI_IOC_RD_MAX_SPEED_HZ, &speed);
	if (ret == -1)
		pabort("can't get max speed hz");

	printf("spi mode: %d\n", mode);
	printf("bits per word: %d\n", bits);
	printf("max speed: %d Hz (%d KHz)\n", speed, speed/1000);

	return;
}

//=====================================================================================================================
//Body=================================================================================================================
//=====================================================================================================================

void update_on_boot() {
	// Preset the Map here
	//setMap(0x000000);

	// Display the Date and Time, comment out this section to display image
	//       "               "
	fillLine("Hello World!   ", 0, 0xFFFFFF); //15 character		
	fillLine("The time is:   ", 1, 0xFF0000); //15 character		
	char* text = getTimestr();
	fillLine(text, 2, 0x00FF00);
	text = getDatestr();
	fillLine(text, 3, 0x0000FF);
	fillLine("ABCDEDFGHIJKLMN", 4, 0x00FFFF); //15 character	
	//*///
}

void update_on_sec() {
	//Insert MAP modification code per second ======
	//Comment this section out to display image
	char* text = getTimestr();
	fillLine(text, 2, 0x00FF00);
	text = getDatestr();
	fillLine(text, 3, 0x0000FF);
	
	//*/// MAP modification code ends ==================
	printMap();

}

void update_on_FPS() {
	/*//Insert MAP modification code on hz ======
	scrollMap(1);
	printMap();
	char* text = getTimestr();
	fillLine(text, 2, 0x00FF00);
	text = getDatestr();
	fillLine(text, 3, 0x0000FF);

	//*/
}

//=====================================================================================================================
//Body End=============================================================================================================
//=====================================================================================================================


void *thread_hz () {
	char x;
	bool dist = false;					
	// Distributed Load, requires 7x rpm, untested
	if(dist) {
		cycle(fd, 1);
		cycle(fd, 2);
		cycle(fd, 2);
		cycle(fd, 4);
		cycle(fd, 4);
		cycle(fd, 4);
		cycle(fd, 4);
	}

	// No distribution
	if(!dist) {
		// Draw all BCM frames at once per X coordinate
		for(x = 0; x < X_COORDS; ++x) {
			cycleOne(fd, x, 1);
			cycleOne(fd, x, 2);
			cycleOne(fd, x, 2);
			cycleOne(fd, x, 4);
			cycleOne(fd, x, 4);
			cycleOne(fd, x, 4);
			cycleOne(fd, x, 4);
		}
	}		
}

void *thread_sec () {
	char i;
	for(i = 0; i < REFRESH_HERTZ; ++i) { // Hz and Sync, any higher syncs cause large delay, tuning with timers is costly
		pthread_t *tid = malloc( sizeof(pthread_t) );
        pthread_create( &tid, NULL, thread_hz, NULL);
        
        update_on_FPS();
        //printf("%d", i); puts("");

		usleep(TIMESYNC_HZ);						
		pthread_join(tid, NULL);		
	}
}

int main() {
	int ret = 0;
	sleep(1);

	setAll(0x000000);

	sleep(1);
	
	struct sched_param sp = { .sched_priority = 50 };
	ret = sched_setscheduler(0, SCHED_FIFO, &sp);
	if ( ret == -1) {
		pabort("set SCHED_FIFO failed");
	}

	fd = open(device, O_RDWR);
	if (fd < 0)
		pabort("can't open device");
	init(fd);

	scroll_offset_X = 0;
	scroll_offset_Y = 0;
	
	char r = 0;
	char x = 0;
	char i = 0;
	char frame = 0;
	unsigned long start;

	update_on_boot();

	while(1) {
		struct timeval time;
		pthread_t *tid = malloc( sizeof(pthread_t) );
        pthread_create( &tid, NULL, thread_sec, NULL);
		
		gettimeofday(&time, NULL);
		start = ((unsigned long long)time.tv_sec * 1000000) + time.tv_usec;

		update_on_sec();

		struct timeval timesync;
		gettimeofday(&timesync, NULL);
		unsigned long sync = ((unsigned long long)timesync.tv_sec * 1000000) + timesync.tv_usec;
		usleep(TIMESYNC_SEC - (start - sync ));
		pthread_join( tid, NULL );

		struct timeval time2;
		gettimeofday(&time2, NULL);
		unsigned long long next = ((unsigned long long)time2.tv_sec * 1000000) + time2.tv_usec;

		long diff = next - start;

		int msec = diff / 1000; // CLOCKS_PER_SEC = 1000000
		printf("Time taken raw %d, %d milliseconds", diff, msec);
		puts("");
	}

	puts("");

	return 0;
}


